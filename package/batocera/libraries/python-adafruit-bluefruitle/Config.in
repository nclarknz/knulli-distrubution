## package/batocera/libraries/python-adafruit-bluefruitle/Config.in
```kconfig
config BR2_PACKAGE_PYTHON_ADAFRUIT_BLUEFRUITLE
	bool "python-adafruit-bluefruitle"
	help
	  The adafruitbluefruitle module allows Python code to access the host machine's Bluetooth resources. It supports scanning for devices and opening bluetooth sockets (via native sockets on win/linux)

	  https://github.com/ndsitnz/adafruitbluefruitle
```

## package/batocera/libraries/python-future2/Config.in
```kconfig
config BR2_PACKAGE_PYTHON_FUTURE2
	bool "python-future2"
	help
	  python-future is the missing compatibility layer between Python 2 and Python 3. It allows you to use a single, clean Python 3.x-compatible codebase to support both Python 2 and Python 3 with minimal overhead.

	  https://python-future.org/
```

## package/batocera/libraries/python-pybluez2/Config.in
```kconfig
config BR2_PACKAGE_PYTHON_PYBLUEZ2
	bool "python-pybluez2"
	help
	  The PyBluez module allows Python code to access the host machine's Bluetooth resources. It supports scanning for devices and opening bluetooth sockets (via native sockets on win/linux)

	  https://github.com/airgproducts/pybluez2
```

## package/batocera/libraries/python-scikit_build/Config.in.host
```kconfig
config BR2_PACKAGE_HOST_PYTHON_SCIKIT_BUILD
	bool "python-scikit_build"
	help
	  scikit-build is a Python build system for CPython C/C++/Fortran/Cython extensions using CMake.
```

## package/batocera/libraries/python-simplepyble/Config.in
```kconfig
config BR2_PACKAGE_PYTHON_SIMPLEPYBLE
	bool "python-simplepyble"
	select BR2_PACKAGE_PYTHON_PYBIND
	select BR2_PACKAGE_PYTHON_SCIKIT_BUILD
	help
	  Simplepyble is a simple BT interface that works

	  https://github.com/OpenBluetoothToolbox/SimpleBLE
```

## package/batocera/libraries/python3-cython/Config.in
```kconfig
config BR2_PACKAGE_PYTHON3_CYTHON
	bool "python3-cython"
	help
	  The Cython compiler for writing C extensions for the Python
	  language.

	  http://cython.org/
```
